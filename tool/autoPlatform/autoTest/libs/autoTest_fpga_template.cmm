ON ERROR CONTinue
area
system.config slave off
system.reset
system.RESetTarget

sys.reset
system.jtagclock 2Mhz
print "do cpu and ddr init"

LOCAL &scriptpath
&scriptpath=".\tool\autoTest_script"
path &scriptpath
do autotest_single_a53_aquilaC_fpga.cmm

print "end of jtag chain config"

data.load.elf &scriptpath"\aquilac_fpga_ddr_init_test.axf"
go
wait 8.s
break

print "end of ddr init "
print "load test code......"
data.load.elf test.axf

print "write log file......"
TERM.RESet
TERM.METHOD SingleE EAXI:0xd4282a48 EAXI:0xd4282a50
TERM.SIZE 60 200
TERM.MODE VT100
TERM.SCROLL ON
TERM.view
SCREEN.ALways
TERM.WRITE EAXI:0xd4282a48 c:\autoTest.log


print "running c code......"
go
wait 0.3s

TERM.Out EAXI:0xd4282a50 " " 10.
wait 0.3s

TERM.Out EAXI:0xd4282a50 "ls" 10.
wait 1s

TERM.Out EAXI:0xd4282a50 "fault_cmd" 10.

wait 5s
break

print "End of running ctest "

TERM.close
SCREEN.ON
print "End of TERM.close"
wait 1s

stop
enddo
