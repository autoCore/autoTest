ON ERROR CONTinue
area
system.config slave off
system.reset
system.RESetTarget

wait 2s
sys.reset
system.jtagclock 2Mhz
print "do cpu and ddr init"

LOCAL &scriptpath
&scriptpath=".\tool\autoTest_script"
path &scriptpath
do main.cmm

print "running ddr init code......"
data.load.elf &scriptpath"/aquila_evb_ddr_training_ok-78M_test.axf"
go
wait 5.s
break

system.jtagclock 10Mhz

print "end of ddr init "
print "load test code......"
data.load.elf test.axf

print "write log file......"
TERM.RESet
TERM.METHOD SingleE EAXI:0xC0700000 EAXI:0xC0700004
TERM.SIZE 60 200
TERM.MODE VT100
TERM.SCROLL ON
TERM.view
SCREEN.ALways
TERM.WRITE EAXI:0xC0700000 c:\autoTest.log

sys.MemAccess dap
SYStem.CpuAccess Enable

print "running c code......"
go
wait 0.3s

TERM.Out EAXI:0xC0700004 " " 10.
wait 0.3s

TERM.Out EAXI:0xC0800004 "ls" 10.
wait 1s

TERM.Out EAXI:0xC0700004 "fault_cmd" 10.

wait 5s
break
print "End of running ctest "

TERM.close
SCREEN.ON
print "End of TERM.close"
wait 1s

print "waiting reset trace32......"

stop
enddo