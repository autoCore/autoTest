ON ERROR CONTinue
area
system.config slave off
system.reset
system.RESetTarget

wait 2s
sys.reset
system.jtagclock 2Mhz
print "do cpu and ddr init"

LOCAL &scriptpath
&scriptpath=".\tool\autoTest_script"
path &scriptpath
do CA53_ETB_Trace_aquilac.cmm

print "running ddr init code......"
data.load.elf &scriptpath"/spl.elf"
;data.load.Binary spl.pak 0xc0800000
;r.s pc 0xc0801000
go
wait 5.s
break

;Data.Set A:0xD405000C %LE %Long Data.Long(A:0xD405000C)&0x7FFFFFFF|0x80000000

system.jtagclock 5Mhz

print "end of ddr init "
print "load test code......"
data.load.elf test.axf

print "write log file......"
TERM.RESet
TERM.METHOD SingleE EAXI:0xd4282a48 EAXI:0xd4282a50
TERM.SIZE 60 200
TERM.MODE VT100
TERM.SCROLL ON
TERM.view
SCREEN.ALways
TERM.WRITE EAXI:0xd4282a48 c:\autoTest.log

sys.MemAccess dap
SYStem.CpuAccess Enable

print "running c code......"
go
wait 0.3s

TERM.Out EAXI:0xd4282a50 " " 10.
wait 0.3s

TERM.Out EAXI:0xd4282a50 "ls" 10.
wait 1s

TERM.Out EAXI:0xd4282a50 "fault_cmd" 10.

wait 1s
break
print "End of running ctest "

TERM.close
SCREEN.ON
print "End of TERM.close"
wait 1s

print "waiting reset trace32......"
wait 1
stop
enddo
