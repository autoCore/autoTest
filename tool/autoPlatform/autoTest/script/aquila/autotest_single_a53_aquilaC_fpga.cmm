
jtag.pin nreset 0 
jtag.pin nreset 1 
sys.reset

system.jtagclock 1Mhz
JTAG.PIN DISABLE
JTAG.PIN ENable                  ; enable JTAG output driver

jtag.pin tck high
jtag.pin tdi low


JTAG.PIN NRESET HIGH
JTAG.PIN NTRST LOW
WAIT 50.MS ; wait until reset is active
JTAG.PIN NTRST HIGH
WAIT 50.MS ; wait until reset is released


;system.config IRPRE 0.
;system.config IRPOST 0.
;system.config DRPRE 0.
;system.config DRPOST 0.
;

JTAG.SHIFTTMS 1 1 1 1 1                                                         ; soft reset of the JTAG interface, goto Test-Logic Reset state
JTAG.SHIFTTMS 0 1 1 0 0                                                         ; goto Shift-IR state
JTAG.SHIFTREG 1 1 1 1 1 1 1 1 0                                                        ; shift in IDCODE instruction
JTAG.SHIFTTMS 1 1 0 0                                                           ; goto Shift-DR state
JTAG.SHIFTREG 0 0 0 0 0 0 0 0 0 0 0 0 0 0 0 0 0 0 0 0 0 0 0 0 0 0 0 0 0 0 0 0   ; shift in 32 dummy bits to get the IDCODE
PRINT JTAG.SHIFT()                                                              ; print result

;step 2
;send ir(16) = 0xffff
JTAG.SHIFTTMS 1 1 1 1 1                                                         ; soft reset of the JTAG interface, goto Test-Logic Reset state
JTAG.SHIFTTMS 0 1 1 0 0                                                         ; goto Shift-IR state
JTAG.SHIFTREG 1 1 1 1 1 1 1 1 1 1 1 1 1 1 1 1					; 16 bits
print.FORMAT.BINary(16,JTAG.SHIFT())

JTAG.SHIFTTMS 1 0 0	;to run time/idle

JTAG.SHIFTTMS 0 1 1 0 0                                                         ; goto Shift-IR state

JTAG.SHIFTREG 0 0 0 1 1 0 0 1 0                                                        ; shift in 0x98 9 instruction
print.FORMAT.BINary(16,JTAG.SHIFT())
JTAG.SHIFTTMS 1

jtag.pin tck high
jtag.pin tms Low

JTAG.SHIFTTMS 1 0 0                                                           ; goto Shift-DR state
JTAG.SHIFTREG 0 1 0 1 0 0 0 0 0 0 0 0 0 0 0 0   ; 0x0a

print.FORMAT.BINary(16,JTAG.SHIFT())
Jtag.shifttms 1 0 0 0

;step 3, read dap id
;send ir(16) = 0xffff
JTAG.SHIFTTMS 1 1 0 0                                                         ; goto Shift-IR state
JTAG.SHIFTREG 1 1 1 1 1 1 1 1 1 1 1 1 1 1 1 1					;15 bits
print.FORMAT.BINary(16,JTAG.SHIFT())
JTAG.SHIFTTMS 1 0 0

;ir(14)=$0x3ffd,
JTAG.SHIFTTMS 0 1 1 0 0                                                         ; goto Shift-IR state

JTAG.SHIFTREG 1 0 1 1 1 1 1 1 1 1 1 1 1 1                                     ; shift in IDCODE instruction 0x3ffd
print.FORMAT.BINary(16,JTAG.SHIFT())

;JTAG.SHIFTTMS 1
;jtag.pin tck high
;jtag.pin tms Low
;JTAG.SHIFTTMS 1 0 0                                                           ; goto Shift-DR state

JTAG.SHIFTTMS 1 1 0 0

JTAG.SHIFTREG 0 0 0 0 0 0 0 0 0 0 0 0 0 0 0 0 0 0 0 0 0 0 0 0 0 0 0 0 0 0 0 0 0 0   ; shift in 34 dummy bits to get the IDCODE

print JTAG.SHIFT()

JTAG.SHIFTTMS 1 0 0 1                                                            ;select dr-status

;end

;JTAG.PIN DISable                                                                ; disable JTAG output driver

system.option enreset off
system.option trst off
system.config slave on


system.config DAPIRPRE 1.
system.config DAPIRPOST 9.
system.config DAPDRPRE 1.
system.config DAPDRPOST 1.


;;
&CORE_N=1 ;1,2
SYStem.CONFIG CoreNumber &CORE_N

IF (&CORE_N==2)
(
	CORE.ASSIGN 1 2
)
ELSE
(
	CORE.ASSIGN 1
)
;;

system.cpu CORTEXA53
SYStem.CONFIG CoreNumber &CORE_N

system.config MEMORYACCESSPORT 0
system.config AXIACCESSPORT   0
system.config DEBUGACCESSPORT 1

SYStem.MemAccess DAP
SYStem.CpuAccess Enable


IF (&CORE_N==1)
(
	sys.config corebase 0xD5410000
	SYS.CONFIG.CTIBase       0xD5420000
)
ELSE IF (&CORE_N==2)
(
	SYStem.CONFIG.COREDEBUG.Base (0xD5410000) (0xD5c10000)
	;SYStem.CONFIG.BMC.Base (0x81430000+&BIG_LIT) (0x81530000+&BIG_LIT) (0x81630000+&BIG_LIT) (0x81730000+&BIG_LIT)
	SYStem.CONFIG.CTI.Base (0xD5420000) (0xD5c20000)
	;SYStem.CONFIG.ETM.Base (0x81440000+&BIG_LIT) (0x81540000+&BIG_LIT) (0x81640000+&BIG_LIT) (0x81740000+&BIG_LIT)
)
system.attach

break



ENDDO


