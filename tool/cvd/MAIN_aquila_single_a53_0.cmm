
;====================================================================================
; The debugger is in DOWN mode, the JTAG driver is tristated.

SCREEN.ON

; Debugger Reset

;;; WinPAGE.RESet
AREA.RESet
WinPOS 0. 26. 75. 8. 0. 0. W000
AREA.view 

system.jtagclock 2Mhz
JTAG.PIN DISABLE
JTAG.PIN ENable                  ; enable JTAG output driver

jtag.pin tck high
jtag.pin tdi low 


JTAG.PIN NRESET HIGH
JTAG.PIN NTRST LOW
WAIT 50.MS ; wait until reset is active
JTAG.PIN NTRST HIGH
WAIT 50.MS ; wait until reset is released


system.config IRPRE 0. 
system.config IRPOST 0.
system.config DRPRE 0.
system.config DRPOST 0.
;

JTAG.SHIFTTMS 1 1 1 1 1                                                         ; soft reset of the JTAG interface, goto Test-Logic Reset state
JTAG.SHIFTTMS 0 1 1 0 0                                                         ; goto Shift-IR state
JTAG.SHIFTREG 1 1 1 1 1 1 1 1 0                                                        ; shift in IDCODE instruction
JTAG.SHIFTTMS 1 1 0 0                                                           ; goto Shift-DR state
JTAG.SHIFTREG 0 0 0 0 0 0 0 0 0 0 0 0 0 0 0 0 0 0 0 0 0 0 0 0 0 0 0 0 0 0 0 0   ; shift in 32 dummy bits to get the IDCODE
PRINT JTAG.SHIFT()                                                              ; print result

;step 2
;send ir(16) = 0xffff
JTAG.SHIFTTMS 1 1 1 1 1                                                         ; soft reset of the JTAG interface, goto Test-Logic Reset state
JTAG.SHIFTTMS 0 1 1 0 0                                                         ; goto Shift-IR state
JTAG.SHIFTREG 1 1 1 1 1 1 1 1 1 1 1 1 1 1 1 1					; 16 bits
print.FORMAT.BINary(16,JTAG.SHIFT())

JTAG.SHIFTTMS 1 0 0	;to run time/idle

JTAG.SHIFTTMS 0 1 1 0 0                                                         ; goto Shift-IR state

JTAG.SHIFTREG 0 0 0 1 1 0 0 1 0                                                        ; shift in 0x98 9 instruction
print.FORMAT.BINary(16,JTAG.SHIFT())
JTAG.SHIFTTMS 1 

;jtag.pin tck high
;jtag.pin tms Low

JTAG.SHIFTTMS 0 1 0 0                                                           ; goto Shift-DR state
JTAG.SHIFTREG 0 1 0 1 0 0 0 0 0 0 0 0 0 0 0 0   ; 0x0a

print.FORMAT.BINary(16,JTAG.SHIFT())
Jtag.shifttms 1 0 0 0 

;step 3, read dap id
;send ir(16) = 0xffff
JTAG.SHIFTTMS 1 1 0 0                                                         ; goto Shift-IR state
JTAG.SHIFTREG 1 1 1 1 1 1 1 1 1 1 1 1 1 1 1 1					;15 bits
print.FORMAT.BINary(16,JTAG.SHIFT())
JTAG.SHIFTTMS 1 0 0 

;ir(14)=$0x3ffd,
JTAG.SHIFTTMS 0 1 1 0 0                                                         ; goto Shift-IR state

JTAG.SHIFTREG 1 0 1 1 1 1 1 1 1 1 1 1 1 1                                     ; shift in IDCODE instruction 0x3ffd
print.FORMAT.BINary(16,JTAG.SHIFT())

;JTAG.SHIFTTMS 1 
;jtag.pin tck high
;jtag.pin tms Low
;JTAG.SHIFTTMS 1 0 0                                                           ; goto Shift-DR state

JTAG.SHIFTTMS 1 1 0 0

JTAG.SHIFTREG 0 0 0 0 0 0 0 0 0 0 0 0 0 0 0 0 0 0 0 0 0 0 0 0 0 0 0 0 0 0 0 0 0 0   ; shift in 34 dummy bits to get the IDCODE

print JTAG.SHIFT()

JTAG.SHIFTTMS 1 0 0 1                                                            ;select dr-status

;end

;JTAG.PIN DISable                                                                ; disable JTAG output driver

system.option enreset off
system.option trst off
system.config slave on


system.config DAPIRPRE 1. 
system.config DAPIRPOST 9.
system.config DAPDRPRE 1.
system.config DAPDRPOST 1.


;;
SYStem.CONFIG CoreNumber 1
CORE.ASSIGN 1
system.cpu CORTEXA53 

system.config MEMORYACCESSPORT 0
system.config AXIACCESSPORT   0
system.config DEBUGACCESSPORT 1

SYStem.MemAccess DAP
SYStem.CpuAccess Enable

sys.config corebase      0xD5410000
SYS.CONFIG.CTIBase       0xD5420000	
	
system.attach

break

D.S ZSD:0xD405000c %LE %Long 0x80e502ff
D.S ZSD:0xD401503C %LE %Long 0X0
wait 1.
D.S ZSD:0xD401503C %LE %Long 0X3

D.S ZSD:0xD401503C %LE %Long 0X3

D.S ZSD:0xd401e278 %LE %Long 0X2 ;mfp
D.S ZSD:0xd401e27c %LE %Long 0X2 ;mfp

data.load.elf aquila_evb_ddr_training_ok-208M_SIMPLE.axf
;;;data.load.elf aquila_evb_ddr_training_ok-78M_test.axf
go
wait 5.s
break
 
data.set 0 %long 0x14000000  ;set ddr
data.set 0 %long 0x14000000  ;set ddr
data.set 0xd4282db0 %long 0x0 ;set reset address to ddr 0x0
R.S PC 0
data.set 0xd428292c %long 0x100 ;releae artems
data.set 0xd428292c %long 0x3ff ;releae 10 cores

data.set 0xD4051084 0x101 ;release cr7
data.set 0xD4282C04 0x22800
data.set 0xD4051020 0xc00081c2

ENDDO


