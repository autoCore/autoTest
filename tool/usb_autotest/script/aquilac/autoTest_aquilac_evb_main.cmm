ON ERROR CONTinue
area
system.config slave off
system.reset
system.RESetTarget

wait 0.5s
sys.reset
system.jtagclock 10Mhz
print "do cpu and ddr init"

LOCAL &scriptpath
;&scriptpath="./tool/autoTest/script/aquilac"
;path &scriptpath
do CA53_ETB_Trace_aquilac.cmm

print "running ddr init code......"
;data.load.elf &scriptpath"/ddr_init.elf"
data.load.elf ddr_init.elf
go
wait 3.s
break

;Data.Set A:0xD405000C %LE %Long Data.Long(A:0xD405000C)&0x7FFFFFFF|0x80000000

system.jtagclock 10Mhz

print "end of ddr init "

enddo
