; --------------------------------------------------------------------------------
; if system is running, size is bigger than 32. if system halt, we should make the system
; to prepare status.


; Checking if ETB is a CoreSight or TAP based ETB
&etbbase=ADDRESS.OFFSET(ETBBASE())
&depth=0

IF &etbbase==0
(
	&depth=Data.Long(EETB:1)
)
ELSE
(
	&depth=Data.Long(EDAP:&etbbase+0x004)
)

IF &depth==0
(
	DIALOG.OK "Size of the ETB is zero!"
	ENDDO
)

; set read pointer to the beginning
IF &etbbase==0
(
	Data.Set ETB:5 %Long Data.Long(EETB:6)
)
ELSE
(
	Data.Set EDAP:&etbbase+0x014 %Long Data.Long(EDAP:&etbbase+0x018)
)

; Readout content
&addr=0
WHILE &addr<=(&depth*4)-1
(
	IF &etbbase==0
	(
		Data.Set AVM:&addr %Long Data.Long(EETB:0x4)
	)
	ELSE
	(
		Data.Set AVM:&addr %Long Data.Long(EDAP:&etbbase+0x010)
	)
	&addr=&addr+4
)

; Save it into a binary file
Data.SAVE.Binary etb.bin AVM:0x000++((&depth*4)-1)

ENDDO

