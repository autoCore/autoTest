
system.config slave off
system.reset
system.RESetTarget

enddo
