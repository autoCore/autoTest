JTAG.PIN DISABLE
JTAG.PIN ENable                  ; enable JTAG output driver

jtag.pin tck high
jtag.pin tdi low

JTAG.PIN NRESET HIGH
JTAG.PIN NTRST LOW
WAIT 50.MS ; wait until reset is active
JTAG.PIN NTRST HIGH
WAIT 50.MS ; wait until reset is released

JTAG.SHIFTTMS 1 1 1 1 1 0 0 0 0 0                                               ; soft reset of the JTAG interface, goto Test-Logic Reset state
JTAG.SHIFTTMS 0 1 1 0 0                                                         ; goto Shift-IR state
JTAG.SHIFTREG 1 1 1 1 1 1 1 1 0                                                 ; shift in IDCODE instruction
JTAG.SHIFTTMS 1 1 0 0                                                           ; goto Shift-DR state
JTAG.SHIFTREG 0 0 0 0 0 0 0 0 0 0 0 0 0 0 0 0 0 0 0 0 0 0 0 0 0 0 0 0 0 0 0 0   ; shift in 32 dummy bits to get the IDCODE
PRINT JTAG.SHIFT()                                                              ; print result

;step 2
;send ir(16) = 0xffff
JTAG.SHIFTTMS 1 1 1 1 1 0 0 0 0 0                                               ; soft reset of the JTAG interface, goto Test-Logic Reset state

JTAG.SHIFTTMS 0 1 1 0 0                                                         ; goto Shift-IR state
JTAG.SHIFTREG 1 1 1 1 1 1 1 1 1 1 1 1 1 1 1 1                                   ; 16 bits
print.FORMAT.BINary(16,JTAG.SHIFT())

JTAG.SHIFTTMS 1 0 0        ;to run time/idle

JTAG.SHIFTTMS 0 1 1 0 0                                                         ; goto Shift-IR state

JTAG.SHIFTREG 0 0 0 1 1 0 0 1 0                                                        ; shift in 0x98 9 instruction
print.FORMAT.BINary(16,JTAG.SHIFT())
JTAG.SHIFTTMS 1 

jtag.pin tck high
jtag.pin tms Low

JTAG.SHIFTTMS 1 0 0                                                           ; goto Shift-DR state
JTAG.SHIFTREG 0 1 1 1 0 0 0 0 0 0 0 0 0 0 0 0                                   ; DR(16) = 0xE send on primary: connect tl421 on primary jtag
;JTAG.SHIFTREG 0 1 0 1 0 1 1 0 0 0 0 0 0 0 0 0                                   ; DR(16) = 0x6a send on primary: connect tl421 on secondary jtag

print.FORMAT.BINary(16,JTAG.SHIFT())
Jtag.shifttms 1 0 0 0


;step 3, read connected core id
JTAG.SHIFTTMS 1 1 0 0                                                       ; goto Shift-IR state
JTAG.SHIFTREG 1 0 0 0 0 0 1 0 1 1 1 1 1 1 1 1 1 1                                     ; shift in IR of IDCODE  (1)+ (TL421 ID, 8bit0xA0) + (1 1 1 1 1 1 1 1 1)
print.FORMAT.BINary(16,JTAG.SHIFT())
JTAG.SHIFTTMS 1 0 0

JTAG.SHIFTTMS 0 1 0 0
JTAG.SHIFTREG 0 0 0 0 0 0 0 0 0 0 0 0 0 0 0 0 0 0 0 0 0 0 0 0 0 0 0 0 0 0 0 0 0 0   ; shift in (1) + (DR length of connected DAP) + (1) dummy bits to get the DR of IDCODE
print JTAG.SHIFT()
JTAG.SHIFTTMS 1 0 0 1                                                   ;select dr-status

enddo
